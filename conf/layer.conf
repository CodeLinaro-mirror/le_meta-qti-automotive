## conf/machine/include/sa7255.inc
```bitbake
include conf/machine/include/basemachine.inc
include conf/machine/include/qclinux-bbmask.inc

SOC_FAMILY ?= "sa7255"
include conf/machine/include/soc-family.inc
PRODUCT = "${MACHINE}"

# Prefer Wayland/Weston version
PREFERRED_VERSION_weston = "8.0.0"
PREFERRED_VERSION_wayland = "1.18.0"
PREFERRED_VERSION_wayland-native = "1.18.0"
PREFERRED_VERSION_wayland-protocols = "1.20"
PREFERRED_VERSION_wayland-ivi-extension = "2.2.0"

PREFERRED_VERSION_libgpiod = "1.6.4"

# Prefer gbm
PREFERRED_PROVIDER_virtual/libgbm = "gbm"

PREFERRED_VERSION_android-tools = "5.1.1.r37"
PREFERRED_VERSION_adreno = "0.1"
# Prefer adreno
PREFERRED_PROVIDER_virtual/wayland-egl  = "adreno"
PREFERRED_PROVIDER_virtual/egl          = "adreno"
PREFERRED_PROVIDER_virtual/libgles1     = "adreno"
PREFERRED_PROVIDER_virtual/libgles2     = "adreno"

RUSTVERSION = "1.75%"

# Keep use nsp-drv under recipes-mproc-umd
BBMASK:append = " recipes-compute-platform/nsp-drv/nsp-drv_git.bb"

# Enables timestamping functionality during building the kernel
KERNEL_DEBUG_TIMESTAMPS = "1"
# mesa provides these packags and others like virtual/libgl.
# This is to enable mesa, adreno and gbm work together, and pass
# yocot-check-layer script check.
BB_MULTI_PROVIDER_ALLOWED += "virtual/wayland-egl virtual/egl virtual/libgles1 virtual/libgles2 virtual/libgbm"

SERIAL_CONSOLE ?= "${@['', '115200 ttyMSM0'][d.getVar('VARIANT', True) == ('' or 'debug')]}"
SERIAL_CONSOLES = "115200;ttyMSM0"

IMAGE_FSTYPES ?= "ext4"
PAGE_SIZE ?= '4096'
IMAGE_ROOTFS_ALIGNMENT = "4096"
EXTRA_IMAGECMD_ext4 += " -b 4096 "

IMAGE_CLASSES += "qimage"

EXTRA_IMAGEDEPENDS += "qcom-image-boot:do_sign_boot_img"

IMAGE_FEATURES:append = " read-only-rootfs"

MACHINE_FEATURES += "\
    qti-vmm \
    qti-data \
    qti-gunyah \
    qti-core \
    qti-tools \
    early-ramdisk-init \
    qti-umd \
    qti-display \
    qti-graphics \
    qti-multimedia \
    qti-camera \
    qti-security \
    qti-vnw \
    qti-audio-aw \
    qti-compute-platform \
    qti-safety \
"

MACHINE_FEATURES:append = "\
    ${@bb.utils.contains('FACTORY_TEST', '1', 'qti-bluetooth', '', d)} \
    ${@bb.utils.contains('FACTORY_TEST', '1', 'qti-wlan', '', d)} \
    ${@bb.utils.contains('FACTORY_TEST', '1', 'qti-wlan-hsp', '', d)} \
    ${@bb.utils.contains('FACTORY_TEST', '1', 'qti-wlan-hmt', '', d)} \
"

BBMASK:remove:auto-slt = "meta-qti-bsp/meta-qti-base/recipes-wlan"

MACHINE_FEATURES:remove = "\
    ${@bb.utils.contains('FACTORY_TEST', '1', 'qti-vmm', '', d)} \
"

SECTOOLS_VERSION = "sectools-v2"
SECTOOLS_SECURITY_PROFILE = "monaco_tz_security_profile.xml"

EARLY_RAMDISK_KERNEL_MODULES = "\
    kernel-module-pinctrl-msm-${KERNEL_VERSION} \
    kernel-module-qcom-geni-se-${KERNEL_VERSION} \
    kernel-module-qcom-geni-serial-${KERNEL_VERSION} \
    kernel-module-qcom-ipcc-${KERNEL_VERSION} \
    kernel-module-phy-qcom-qmp-ufs-${KERNEL_VERSION} \
    kernel-module-ufs-qcom-${KERNEL_VERSION} \
    kernel-module-ufshcd-core-${KERNEL_VERSION} \
    kernel-module-ufshcd-pltfrm-${KERNEL_VERSION} \
    kernel-module-pinctrl-sa7255p-${KERNEL_VERSION} \
    kernel-module-aquantia-${KERNEL_VERSION}  \
    kernel-module-marvell-${KERNEL_VERSION} \
    kernel-module-virtio-mmio-${KERNEL_VERSION} \
    kernel-module-ipv6-${KERNEL_VERSION} \
    kernel-module-kiumd-${KERNEL_VERSION} \
    kernel-module-iommu-iova-map-${KERNEL_VERSION} \
    kernel-module-tz-ffi-${KERNEL_VERSION} \
    kernel-module-scm-user-intf-${KERNEL_VERSION} \
    kernel-module-scm-user-intf-sec-${KERNEL_VERSION} \
    kernel-module-vfio-platform-base-${KERNEL_VERSION} \
    kernel-module-vfio-platform-${KERNEL_VERSION} \
    kernel-module-kiumd-kgsl-${KERNEL_VERSION} \
    kernel-module-vfio-iommu-qcom-${KERNEL_VERSION} \
    kernel-module-ipcc-shmem-test-module-${KERNEL_VERSION} \
    kernel-module-i2c-qcom-geni-${KERNEL_VERSION} \
    kernel-module-qcom-scm-oot-${KERNEL_VERSION} \
    kernel-module-qtee-shmbridge-${KERNEL_VERSION} \
    kernel-module-qcom-smcinvoke-${KERNEL_VERSION} \
    kernel-module-spidev-${KERNEL_VERSION} \
    kernel-module-qcom-dload-mode-${KERNEL_VERSION} \
    kernel-module-qcom-uscmi-${KERNEL_VERSION} \
    kernel-module-mhi-ep-net-${KERNEL_VERSION} \
    kernel-module-kryo-arm64-edac-${KERNEL_VERSION} \
    kernel-module-socinfo-${KERNEL_VERSION} \
    kernel-module-msm-hab-${KERNEL_VERSION} \
    kernel-module-hyp-udmabuf-${KERNEL_VERSION} \
    kernel-module-mdt-loader-${KERNEL_VERSION} \
    kernel-module-gh-msgq-${KERNEL_VERSION} \
    kernel-module-gh-arm-drv-${KERNEL_VERSION} \
    kernel-module-gh-rm-drv-${KERNEL_VERSION} \
    kernel-module-gunyah-${KERNEL_VERSION} \
    kernel-module-hvc-gunyah-${KERNEL_VERSION} \
"
```

## conf/machine/include/sa8775.inc
```bitbake
include conf/machine/include/basemachine.inc
include conf/machine/include/qclinux-bbmask.inc

SOC_FAMILY = "sa8775"
include conf/machine/include/soc-family.inc
PRODUCT = "${MACHINE}"

include conf/machine/include/arm/armv8-2a/tune-cortexa78c.inc
TUNE_FEATURES:tune-cortexa78c = "${TUNE_FEATURES:tune-armv8-2a-crypto} cortexa78c"

# Prefer Wayland/Weston version
PREFERRED_VERSION_weston = "8.0.0"
PREFERRED_VERSION_wayland = "1.18.0"
PREFERRED_VERSION_wayland-native = "1.18.0"
PREFERRED_VERSION_wayland-protocols = "1.20"
PREFERRED_VERSION_wayland-ivi-extension = "2.2.0"
# Prefer gbm
PREFERRED_PROVIDER_virtual/libgbm = "gbm"

PREFERRED_VERSION_android-tools = "5.1.1.r37"
PREFERRED_VERSION_adreno = "0.1"
# Prefer adreno
PREFERRED_PROVIDER_virtual/wayland-egl  = "adreno"
PREFERRED_PROVIDER_virtual/egl          = "adreno"
PREFERRED_PROVIDER_virtual/libgles1     = "adreno"
PREFERRED_PROVIDER_virtual/libgles2     = "adreno"

BBMASK += "meta-qti-bsp/meta-qti-base/recipes-wlan"

RUSTVERSION = "1.75%"

# Enables timestamping functionality during building the kernel
KERNEL_DEBUG_TIMESTAMPS = "1"
# mesa provides these packags and others like virtual/libgl.
# This is to enable mesa, adreno and gbm work together, and pass
# yocot-check-layer script check.
BB_MULTI_PROVIDER_ALLOWED += "virtual/wayland-egl virtual/egl virtual/libgles1 virtual/libgles2 virtual/libgbm"

SERIAL_CONSOLE ?= "${@['', '115200 ttyMSM0'][d.getVar('VARIANT', True) == ('' or 'debug')]}"
SERIAL_CONSOLES = "115200;ttyMSM0"

IMAGE_FSTYPES ?= "ext4"
PAGE_SIZE ?= '4096'
IMAGE_ROOTFS_ALIGNMENT = "4096"
EXTRA_IMAGECMD_ext4 += " -b 4096 "

IMAGE_CLASSES += "qimage"

IMAGE_INSTALL += "\
    openssh-scp \
    openssh-ssh \
    openssh-sshd \
    openssh-sftp \
    openssh-sftp-server \
    "

IMAGE_FEATURES += "ssh-server-openssh"

EXTRA_IMAGEDEPENDS += "qcom-image-boot:do_sign_boot_img"

IMAGE_FEATURES:append = " read-only-rootfs"

MACHINE_FEATURES += "\
    qti-core \
    qti-tools \
    qti-multimedia \
    qti-display \
    qti-graphics \
    qti-audio \
    qti-vmm \
    qti-camera \
    qti-safety \
    qti-data \
    qti-vnw \
    early-ramdisk-init \
    qti-security \
    qti-umd \
    qti-gunyah \
    qti-compute-platform \
"

MACHINE_FEATURES:remove = "\
    qti-multimedia \
    qti-display \
    qti-graphics \
    qti-audio \
    qti-vmm \
    qti-camera \
    qti-safety \
    qti-data \
    qti-vnw \
    early-ramdisk-init \
    qti-security \
    qti-umd \
    qti-gunyah \
    qti-compute-platform \
"

MACHINE_FEATURES:append = "\
    ${@bb.utils.contains('FACTORY_TEST', '1', 'qti-bluetooth', '', d)} \
"

MACHINE_FEATURES:remove = "\
    ${@bb.utils.contains('TCMODE', 'external-ubuntu', 'qti-vmm', '', d)} \
    ${@bb.utils.contains('FACTORY_TEST', '1', 'qti-vmm', '', d)} \
"

SECTOOLS_VERSION = "sectools-v2"
SECTOOLS_SECURITY_PROFILE = "lemans_tz_security_profile.xml"

EARLY_RAMDISK_KERNEL_MODULES = "\
    kernel-module-pinctrl-msm-${KERNEL_VERSION} \
    kernel-module-qcom-geni-se-${KERNEL_VERSION} \
    kernel-module-qcom-geni-serial-${KERNEL_VERSION} \
    kernel-module-qcom-ipcc-${KERNEL_VERSION} \
    kernel-module-phy-qcom-qmp-ufs-${KERNEL_VERSION} \
    kernel-module-ufs-qcom-${KERNEL_VERSION} \
    kernel-module-ufshcd-core-${KERNEL_VERSION} \
    kernel-module-ufshcd-pltfrm-${KERNEL_VERSION} \
    kernel-module-pinctrl-sa8775p-${KERNEL_VERSION} \
    kernel-module-aquantia-${KERNEL_VERSION}  \
    kernel-module-marvell-${KERNEL_VERSION} \
    kernel-module-virtio-mmio-${KERNEL_VERSION} \
    kernel-module-ipv6-${KERNEL_VERSION} \
    kernel-module-kiumd-${KERNEL_VERSION} \
    kernel-module-iommu-iova-map-${KERNEL_VERSION} \
    kernel-module-scm-user-intf-${KERNEL_VERSION} \
    kernel-module-vfio-platform-base-${KERNEL_VERSION} \
    kernel-module-vfio-platform-${KERNEL_VERSION} \
    kernel-module-kiumd-kgsl-${KERNEL_VERSION} \
    kernel-module-vfio-iommu-qcom-${KERNEL_VERSION} \
    kernel-module-ipcc-shmem-test-module-${KERNEL_VERSION} \
    kernel-module-i2c-qcom-geni-${KERNEL_VERSION} \
    kernel-module-qcom-scm-oot-${KERNEL_VERSION} \
    kernel-module-qtee-shmbridge-${KERNEL_VERSION} \
    kernel-module-qcom-smcinvoke-${KERNEL_VERSION} \
    kernel-module-spidev-${KERNEL_VERSION} \
    kernel-module-qcom-dload-mode-${KERNEL_VERSION} \
    kernel-module-qcom-uscmi-${KERNEL_VERSION} \
    kernel-module-mhi-ep-net-${KERNEL_VERSION} \
    kernel-module-kryo-arm64-edac-${KERNEL_VERSION} \
    kernel-module-socinfo-${KERNEL_VERSION} \
"
```

## conf/machine/include/sa8797.inc
```bitbake
include conf/machine/include/basemachine.inc
include conf/machine/include/qclinux-bbmask.inc
SOC_FAMILY = "sa8797"
SOC_FAMILY ?= "sa-common"
include conf/machine/include/soc-family.inc
PRODUCT = "${MACHINE}"
PREFERRED_PROVIDER_virtual/kernel = "linux-qcom-custom-rt"
PREFERRED_PROVIDER_virtual/kernel-headers = "linux-kernel-qcom-headers"
PREFERRED_VERSION_linux-qcom-custom-rt = "6.6"

# Prefer Wayland/Weston version
PREFERRED_VERSION_weston = "8.0.0"
PREFERRED_VERSION_wayland = "1.18.0"
PREFERRED_VERSION_wayland-native = "1.18.0"
PREFERRED_VERSION_wayland-protocols = "1.20"
PREFERRED_VERSION_wayland-ivi-extension = "2.2.0"
preferred-kernel = "PREFERRED_VERSION_linux-qcom-custom-rt"
kernel-version = "6.6"
# Prefer gbm
PREFERRED_PROVIDER_virtual/libgbm = "gbm"

PREFERRED_VERSION_adreno = "0.1"
# Prefer adreno
PREFERRED_PROVIDER_virtual/wayland-egl  = "adreno"
PREFERRED_PROVIDER_virtual/egl          = "adreno"
PREFERRED_PROVIDER_virtual/libgles1     = "adreno"
PREFERRED_PROVIDER_virtual/libgles2     = "adreno"

BBMASK:sa8797 += "meta-qti-bsp/meta-qti-base/recipes-kernel/edk2/edk2_4.0.bb"
BBMASK:sa8797 += "meta-qti-bsp/meta-qti-base/recipes-kernel/edk2/edk2_5.0.bb"

# Enables timestamping functionality during building the kernel
KERNEL_DEBUG_TIMESTAMPS = "1"
# mesa provides these packags and others like virtual/libgl.
# This is to enable mesa, adreno and gbm work together, and pass
# yocot-check-layer script check.
BB_MULTI_PROVIDER_ALLOWED += "virtual/wayland-egl virtual/egl virtual/libgles1 virtual/libgles2 virtual/libgbm"

SERIAL_CONSOLE ?= "${@['', '115200 ttyMSM0'][d.getVar('VARIANT', True) == ('' or 'debug')]}"
SERIAL_CONSOLES = "115200;ttyMSM0"

IMAGE_FSTYPES ?= "ext4"
PAGE_SIZE ?= '4096'
IMAGE_ROOTFS_ALIGNMENT = "4096"
EXTRA_IMAGECMD_ext4 += " -b 4096 "

IMAGE_CLASSES += "qimage"

IMAGE_INSTALL += "\
    openssh-scp \
    openssh-ssh \
    openssh-sshd \
    openssh-sftp \
    openssh-sftp-server \
    "
IMAGE_INSTALL:remove = "${@bb.utils.contains('DISTRO_FEATURES', 'qti-rumi', 'openssh-scp openssh-ssh openssh-sshd openssh-sftp openssh-sftp-server', '', d)}"


IMAGE_FEATURES += "ssh-server-openssh"

EXTRA_IMAGEDEPENDS += "qti-image-ark-boot:do_sign_boot_img"

IMAGE_FEATURES:append = " read-only-rootfs"

MACHINE_FEATURES += "\
    qti-bluetooth \
    qti-core \
    qti-tools \
    qti-multimedia \
    qti-cv \
    qti-display \
    qti-graphics \
    qti-audio-aw \
    qti-data \
    qti-camera \
    qti-safety \
    qti-vnw \
    early-ramdisk-init \
    qti-security \
    qti-umd \
    qti-vmm \
"
MACHINE_FEATURES:remove = "\
    qti-safety \
    early-ramdisk-init \
"

SECTOOLS_VERSION = "sectools-v2"
SECTOOLS_V2_DIR = "${BSPDIR}/vendor/qcom/proprietary/sectools/Linux"
SECTOOLS_SECURITY_PROFILE = "${BSPDIR}/security/securemsm/security_profiles/nord_tz_security_profile.xml"
```

## conf/machine/include/sa8797dc.inc
```bitbake
include conf/machine/include/basemachine.inc
include conf/machine/include/qclinux-bbmask.inc

SOC_FAMILY = "sa8797"
SOC_FAMILY ?= "sa-common"
include conf/machine/include/soc-family.inc
PRODUCT = "${MACHINE}"
PREFERRED_PROVIDER_virtual/kernel = "linux-qcom-custom"
PREFERRED_VERSION_linux-qcom-custom = "6.6"
PREFERRED_PROVIDER_virtual/kernel-headers = "linux-kernel-qcom-headers"

preferred-kernel = "PREFERRED_VERSION_linux-qcom-custom"
kernel-version = "6.6"

# Enables timestamping functionality during building the kernel
KERNEL_DEBUG_TIMESTAMPS = "1"

SERIAL_CONSOLE ?= "${@['', '115200 ttyMSM0'][d.getVar('VARIANT', True) == ('' or 'debug')]}"
SERIAL_CONSOLES = "115200;ttyMSM0"

IMAGE_FSTYPES ?= "ext4"
PAGE_SIZE ?= '4096'
IMAGE_ROOTFS_ALIGNMENT = "4096"
EXTRA_IMAGECMD_ext4 += " -b 4096 "

IMAGE_CLASSES += "qimage"

IMAGE_INSTALL += "\
    openssh-scp \
    openssh-ssh \
    openssh-sshd \
    openssh-sftp \
    openssh-sftp-server \
    "

IMAGE_FEATURES += "ssh-server-openssh debug-tweaks"

EXTRA_IMAGEDEPENDS += "qcom-image-boot:do_sign_boot_img"

IMAGE_FEATURES:remove = " read-only-rootfs"

MACHINE_FEATURES:append = "\
    qti-core \
    qti-tools \
    ${@bb.utils.contains("ACTUAL_KERNEL", "linux-ark", "qti-gunyah", "", d)} \
    early-ramdisk-init \
"

SECTOOLS_VERSION = "sectools-v2"
SECTOOLS_SECURITY_PROFILE = "nord_tz_security_profile.xml"
SECTOOLS_V2_DIR = "${BSPDIR}/vendor/qcom/proprietary/sectools/Linux"
```

## conf/machine/include/tune-oryon-1.inc
```bitbake
#
# Tune Settings for oryon-1
#
DEFAULTTUNE ?= "oryon-1"

TUNEVALID[oryon-1] = "Enable oryon-1 specific processor optimizations"
TUNE_CCARGS .= "${@bb.utils.contains('TUNE_FEATURES', 'oryon-1', ' -mcpu=oryon-1', '', d)}"

require conf/machine/include/arm/arch-armv8-6a.inc

AVAILTUNES                                         += "oryon-1"
ARMPKGARCH:tune-oryon-1                             = "oryon-1"
TUNE_FEATURES:tune-oryon-1                          = "aarch64 oryon-1"
PACKAGE_EXTRA_ARCHS:tune-oryon-1                    = "${PACKAGE_EXTRA_ARCHS:tune-armv8-6a-crypto} oryon-1"
BASE_LIB:tune-oryon-1                               = "lib64"
```
