## conf/machine/qclinux-gvm-gen5.conf
```bitbake
#@TYPE: Machine
#@NAME: qclinux-gvm-gen5
#@DESCRIPTION: Machine configuration for QTI SH GVM NORD(GEN5) Platform

BASEMACHINE ?= "qclinux-gvm-gen5"
include conf/machine/include/auto-common.inc

#MASK unused recipe in target
include conf/machine/include/qclinux-bbmask.inc
include conf/distro/include/qclinux-bbmask-prop.inc

include conf/machine/include/tune-oryon-1.inc

PREFERRED_PROVIDER_dtc-native = "dtc-aosp-native"

PREFERRED_PROVIDER_virtual/kernel = "linux-qcom-custom-rt"
PREFERRED_PROVIDER_virtual/kernel-headers = "linux-kernel-qcom-headers"
PREFERRED_VERSION_linux-qcom-custom-rt = "6.6"
PREFERRED_VERSION_linux-qcom-custom = "6.6"
preferred-kernel = "PREFERRED_VERSION_linux-qcom-custom-rt"
kernel-version = "6.6"
PREFERRED_VERSION_media-codec2 = "auto.1.0"
PREFERRED_VERSION_media-external = "auto.1.0"
PREFERRED_VERSION_media-noship = "auto.1.0"
#PREFERRED_VERSION_codec2-service = "auto.1.0"
PREFERRED_VERSION_adreno = "0.1"

# gvm prefer camx
PREFERRED_VERSION_cameradlkm = "0.2"

KERNEL_ARCH = "autogvm"
KERNEL_VARIANT = "${@bb.utils.contains_any('VARIANT', 'perf user', 'perf_', 'debug_', d)}"
KERNEL_DEFCONFIG_VARIANT = "${@bb.utils.contains_any('VARIANT', 'perf user', 'defconfig', 'debug-defconfig', d)}"
KERNEL_OUT_VARIANT = "${@bb.utils.contains_any('VARIANT', 'perf user', '', 'debug_', d)}"
KERNEL_BUILD_CONFIG = "soc-repo/build.config.msm.${KERNEL_ARCH}.lv"
KERNEL_IMAGE_HEADER_VERSION = "2"

KERNEL_BASE = "0x80000000"
KERNEL_TAGS_OFFSET = "0x1e00000"
KERNEL_CONFIG = "${@['vendor/autogvm_defconfig', 'vendor/autogvm-debug_defconfig'][d.getVar('VARIANT', True) == ('' or 'debug')]}"
KERNEL_CMD_PARAMS = " "
KERNEL_IMAGETYPE = "Image"

MACHINE_FEATURES += "\
    qti-core \
    qti-hypervisor \
    qti-gvm \
    dt-overlay \
    qti-dlkm \
    early-ramdisk-init \
    qti-extra \
    qti-data \
"

KERNEL_CMD_PARAMS:append = "${@bb.utils.contains('MACHINE_FEATURES', 'early-ramdisk-init', ' rdinit=/sbin/early-ramdisk-init early-ramdisk.mode=3 ', '', d)}"
KERNEL_CMD_PARAMS:append = " ro "

EARLY_RAMDISK_KERNEL_MODULES = "\
    kernel-module-virtio-mmio-${KERNEL_VERSION} \
    kernel-module-msm-hab-${KERNEL_VERSION} \
    kernel-module-virtio-blk-${KERNEL_VERSION} \
    kernel-module-gh-dbl-${KERNEL_VERSION} \
    kernel-module-gh-msgq-${KERNEL_VERSION} \
    kernel-module-gh-arm-drv-${KERNEL_VERSION} \
    kernel-module-gh-rm-drv-${KERNEL_VERSION} \
    kernel-module-socinfo-dt-${KERNEL_VERSION} \
"

SECTOOLS_VERSION = "sectools-v2"
SECTOOLS_SECURITY_PROFILE = "nord_security_profile.xml"
```

## conf/machine/sa8797dc-pvm.conf
```bitbake
#@TYPE: Machine
#@NAME: sa8797dc-pvm
#@DESCRIPTION: Machine configuration for QTI sa8797dc

require conf/machine/sa8797dc.conf

MACHINE_FEATURES:append = "pvm"

SVM_MACHINE = "sa8797dc-svm"
SVM_IMAGE = "vm-boot.img"
SVM_DEPLOY_DIR = "${TOPDIR}/tmp-${SVM_MACHINE}-glibc/deploy/images/${SVM_MACHINE}-automotive/"
```

## conf/machine/sa8797dc-svm.conf
```bitbake
#@TYPE: Machine
#@NAME: sa8797dc-svm
#@DESCRIPTION: Machine configuration for QTI sa8797dc-svm

require conf/machine/sa8797dc.conf

EXTRA_IMAGEDEPENDS:remove = "edk2"
MACHINE_FEATURES:append = "svm"

CLOUDAI_SVM_BUILD="1"

KERNEL_MACHINE_DTB = " \
        arch/arm64/boot/dts/qcom/sa8797p-gunyah-vm-dc.dtb \
"

OOT_DTBS = " \
        arch/arm64/boot/dts/qcom/sa8797p-gunyah-vm-dc-overlay.dtbo \
"

DTB_OFFSET = "0x9700000"

KERNEL_CMD_PARAMS = "nosoftlockup console=hvc0,115200n8 qcom_geni_serial.con_enabled=1 androidboot.first_stage_console=1"

# GVM uses hvc0 (virtio console) as its console, not the physical ttyMSM0 from the parent conf
SERIAL_CONSOLES = "115200;hvc0"
```

## conf/machine/sa8797dc.conf
```bitbake
#@TYPE: Machine
#@NAME: sa8797dc
#@DESCRIPTION: Machine configuration for QTI sa8797dc

BASEMACHINE = "sa8797dc"
include conf/machine/include/sa8797dc.inc

DEFAULTTUNE = "aarch64"
include conf/machine/include/arm/arch-armv8a.inc

RECOVERY_IMAGE = "0"

PREFERRED_PROVIDER_mkbootimg-native = "mkbootimg-gki-native"
PREFERRED_VERSION_mkbootimg-gki-native = "5.14"

IMAGE_FEATURES:remove = " read-only-rootfs"

EXTRA_IMAGEDEPENDS += "edk2"
CLANG_BIN="${SRC_DIR_ROOT}/prebuilts/clang/host/linux-x86/clang-r416183b/bin/"

KERNEL_IMAGE_HEADER_VERSION = "2"
KERNEL_BASE = "0xE1E00000"
KERNEL_TAGS_OFFSET = "0xE1E00000"
KERNEL_CONFIG = "defconfig"

KERNEL_MACHINE_DTB = "\
        arch/arm64/boot/dts/qcom/sa8797dc.dtb \
        arch/arm64/boot/dts/qcom/sa8797dc-v2.dtb \
"

KERNEL_CMD_PARAMS = "rw rootwait console=ttyMSM0,115200,n8 no_console_suspend=1 root=/dev/ram init=/bin/sh androidboot.hardware=qcom androidboot.console=ttyMSM0 lpm_levels.sleep_disabled=1 msm_rtb.filter=0x237 earlycon=qcom_geni,0x884000 fips=0 notests ignore_loglevel firmware_class.path=/firmware/vm/boot systemd.gpt_auto=0 cgroup.memory=nokmem,nosocket maxcpus=6"
KERNEL_CMD_PARAMS:remove = "${@bb.utils.contains_any('VARIANT', 'perf user', 'console=ttyMSM0,115200,n8', '', d)}"
KERNEL_CMD_PARAMS:remove = "${@bb.utils.contains_any('VARIANT', 'perf user', 'earlycon=qcom_geni,0xa8c000', '', d)}"

KERNEL_IMAGETYPE = "Image"

OOT_DTBS = "\
    arch/arm64/boot/dts/qcom/sa8797p-overlay.dtbo \
"

RUSTVERSION = "1.75%"
```
