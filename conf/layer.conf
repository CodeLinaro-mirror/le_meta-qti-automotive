## conf/layer.conf
```bitbake
BBPATH .= ":${LAYERDIR}"

# We have recipes-* directories, add to BBFILES
BBFILES += "${LAYERDIR}/recipes-*/*/*.bb \
            ${LAYERDIR}/recipes-*/*/*.bbappend \
            ${LAYERDIR}/recipes-*/*.bbappend \
            ${LAYERDIR}/recipes-*/*.bb \
            ${LAYERDIR}/recipes-*/*/*/*.bb \
            ${LAYERDIR}/recipes-*/*/*/*.bbappend \
"

BBFILE_COLLECTIONS += "qti-automotive"
BBFILE_PRIORITY_qti-automotive = "16"
BBFILE_PATTERN_qti-automotive := "^${LAYERDIR}/"
LAYERSERIES_COMPAT_qti-automotive = "kirkstone"

# We have a conf and classes directory, add to BBPATH
BBPATH .= ":${LAYERDIR}"
BSPDIR := "${@os.path.abspath(os.path.dirname(d.getVar('FILE', True)) + '/../../..')}"

LICENSE_PATH += "${LAYERDIR}/files/common-licenses"

# Currently edk2 need python2 to support compilation
HOSTTOOLS_NONFATAL += "python python2"
HOSTTOOLS_NONFATAL += "whoami flex bison"

QTI_METAPATH_BASE := '${@os.path.normpath("${LAYERDIR}/")}'
QTI_LICENSE_DIR = "${QTI_METAPATH_BASE}/files/common-licenses"


# Uncomment this to use a shared download directory
CLO_MIRROR = "https://codelinaro.jfrog.io/artifactory/codelinaro-le/"
CLO_LA_GIT = "git://git.codelinaro.org/clo/la"
CLO_LE_GIT = "git://git.codelinaro.org/clo/le"

PREMIRRORS:append = " https?$://.*/.* ${CLO_MIRROR}/\n"
PREMIRRORS:append = " svn$://.*/.* ${CLO_MIRROR}/\n"
PREMIRRORS:append = " git?$://.*/.* ${CLO_MIRROR}/\n"
PREMIRRORS:append = " ftps?$://.*/.* ${CLO_MIRROR}/\n"

PREMIRRORS:append = " git://github.com/marzer/tomlplusplus.git ${CLO_LE_GIT}/platform/external/tomlplusplus"
```

## conf/machine/gen5.conf
```bitbake
#@TYPE: Machine
#@NAME: gen5
#@DESCRIPTION: Machine configuration for QTI gen5 machine family

BASEMACHINE = "sa8797"
include conf/machine/include/gen5.inc

include conf/machine/include/tune-oryon-1.inc

RECOVERY_IMAGE = "0"

PREFERRED_PROVIDER_mkbootimg-native = "mkbootimg-gki-native"
PREFERRED_VERSION_mkbootimg-gki-native = "5.14"

EXTRA_IMAGEDEPENDS += "edk2"
CLANG_BIN="${SRC_DIR_ROOT}/prebuilts/clang/host/linux-x86/clang-r416183b/bin/"

KERNEL_IMAGE_HEADER_VERSION = "2"
KERNEL_BASE = "0x80000000"
KERNEL_TAGS_OFFSET = "0x1e00000"
KERNEL_CONFIG = "defconfig"
RH_KERNEL_NAME = "rh-fedora-kernel-6.9"
KERNEL_ARCH="gen5auto"

KERNEL_CMD_PARAMS = "rw rootwait console=ttyMSM0,115200,n8 firmware_class.path=/firmware/vm/boot systemd.gpt_auto=0 cgroup.memory=nokmem,nosocket qcom_scm.download_mode=1 page_owner=on rcupdate.rcu_expedited=1 rcu_nocbs=0-17 rcupdate.rcu_normal_after_boot=0 fsck.repair=yes systemd.service_watchdogs=0 driver_async_probe=scmi-hwmon "
KERNEL_CMD_PARAMS:append = "${@bb.utils.contains('MACHINE_FEATURES', 'early-ramdisk-init', ' rdinit=/sbin/early-ramdisk-init early-ramdisk.mode=3 ', '', d)}"
KERNEL_CMD_PARAMS:remove = "${@bb.utils.contains_any('VARIANT', 'perf user', 'console=ttyMSM0,115200,n8', '', d)}"
#KERNEL_CMD_PARAMS:remove = "${@bb.utils.contains_any('VARIANT', 'perf user', 'earlycon=qcom_geni,0x884000', '', d)}"
KERNEL_CMD_PARAMS:remove = "${@bb.utils.contains('IMAGE_FEATURES', 'read-only-rootfs', 'rw', '', d)}"
KERNEL_CMD_PARAMS:remove = "${@bb.utils.contains_any('VARIANT', 'perf user', 'page_owner=on', '', d)}"
KERNEL_CMD_PARAMS:append = "${@bb.utils.contains_any('VARIANT', 'perf user', '', 'kmemleak=off ', d)}"
KERNEL_CMD_PARAMS:append = "${@bb.utils.contains_any('VARIANT', 'perf user', 'bootmem_limit=4G ', '', d)}"

KERNEL_IMAGETYPE = "Image"

KERNEL_MACHINE_DTB = "\
    arch/arm64/boot/dts/qcom/sa8797p-adp-star.dtb \
    arch/arm64/boot/dts/qcom/sa8797p-non-safe-ivi-adp-star.dtb \
    arch/arm64/boot/dts/qcom/sa8797p-adp-star-pcie-ep.dtb \
    arch/arm64/boot/dts/qcom/sa8797p-qam-ride-sx-pcie-ep.dtb \
    arch/arm64/boot/dts/qcom/sa8797p-non-safe-ivi-ride-sx.dtb \
    arch/arm64/boot/dts/qcom/sa8797p-safe-ivi-ride-sx.dtb \
    arch/arm64/boot/dts/qcom/sa8797p-ride-sx.dtb \
    arch/arm64/boot/dts/qcom/sa8797p-multi-gvm-ride-sx.dtb \
    arch/arm64/boot/dts/qcom/sa8797p-non-safe-la-gvm-ride-sx.dtb \
    arch/arm64/boot/dts/qcom/sa8797p-non-safe-multi-gvm-ride-sx.dtb \
    arch/arm64/boot/dts/qcom/sa8797p-la-gvm-ride-sx.dtb \
    arch/arm64/boot/dts/qcom/sa8797p-v2-adp-star.dtb \
    arch/arm64/boot/dts/qcom/sa8797p-v2-non-safe-ivi-adp-star.dtb \
    arch/arm64/boot/dts/qcom/sa8797p-v2-non-safe-ivi-ride-sx.dtb \
    arch/arm64/boot/dts/qcom/sa8797p-v2-safe-ivi-ride-sx.dtb \
    arch/arm64/boot/dts/qcom/sa8797p-v2-ride-sx.dtb \
    arch/arm64/boot/dts/qcom/sa8x97p-qam-pats.dtb \
    arch/arm64/boot/dts/qcom/sa8x97p-safe-ivi-qam-pats.dtb \
    arch/arm64/boot/dts/qcom/sa8x97p-non-safe-ivi-qam-pats.dtb \
    arch/arm64/boot/dts/qcom/sa8x97p-flex-ride-sx.dtb \
    arch/arm64/boot/dts/qcom/sa8x97p-v2-flex-ride-sx.dtb \
    arch/arm64/boot/dts/qcom/sa8x97p-v2-adp-star-pcie-ep.dtb \
    arch/arm64/boot/dts/qcom/sa8x97p-v2-ride-sx-pcie-ep.dtb \
    arch/arm64/boot/dts/qcom/sa8x97p-v2-flex-adp-star.dtb \
"

OOT_DTBS = "\
    arch/arm64/boot/dts/qcom/sa8797p-overlay.dtbo \
"

OOT_DDR_DTBOS = "arch/arm64/boot/dts/qcom/sa8797p-ddr-32gb_overlay.dtbo \
                 arch/arm64/boot/dts/qcom/sa8797p-ddr-48gb_overlay.dtbo \
                 arch/arm64/boot/dts/qcom/sa8797p-ddr-64gb_overlay.dtbo \
                 arch/arm64/boot/dts/qcom/sa8x97p-flex-ddr-32gb_overlay.dtbo \
                 arch/arm64/boot/dts/qcom/sa8x97p-flex-ddr-48gb_overlay.dtbo \
                 arch/arm64/boot/dts/qcom/sa8x97p-flex-ddr-64gb_overlay.dtbo"


EARLY_RAMDISK_KERNEL_MODULES = "\
    kernel-module-phy-qcom-qmp-ufs-${KERNEL_VERSION} \
    kernel-module-marvell-${KERNEL_VERSION} \
    kernel-module-ipv6-${KERNEL_VERSION} \
    kernel-module-kiumd-${KERNEL_VERSION} \
    kernel-module-iommu-iova-map-${KERNEL_VERSION} \
    kernel-module-tz-ffi-${KERNEL_VERSION} \
    kernel-module-scm-user-intf-${KERNEL_VERSION} \
    kernel-module-scm-user-intf-sec-${KERNEL_VERSION} \
    kernel-module-vfio-platform-base-${KERNEL_VERSION} \
    kernel-module-vfio-platform-${KERNEL_VERSION} \
    kernel-module-kiumd-kgsl-${KERNEL_VERSION} \
    kernel-module-vfio-iommu-qcom-${KERNEL_VERSION} \
    kernel-module-ipcc-shmem-test-module-${KERNEL_VERSION} \
    kernel-module-i2c-qcom-geni-${KERNEL_VERSION} \
    kernel-module-spidev-${KERNEL_VERSION} \
    kernel-module-qcom-dload-mode-${KERNEL_VERSION} \
    kernel-module-qcom-uscmi-${KERNEL_VERSION} \
    kernel-module-mhi-ep-net-${KERNEL_VERSION} \
    kernel-module-kryo-arm64-edac-${KERNEL_VERSION} \
    kernel-module-socinfo-${KERNEL_VERSION} \
    kernel-module-phylink-${KERNEL_VERSION} \
    kernel-module-pcs-xpcs-${KERNEL_VERSION} \
    kernel-module-phy-qcom-sgmii-eth-${KERNEL_VERSION} \
    kernel-module-stmmac-${KERNEL_VERSION} \
    kernel-module-stmmac-platform-${KERNEL_VERSION} \
    kernel-module-dwmac-qcom-ethqos-${KERNEL_VERSION} \
    kernel-module-pinctrl-msm-${KERNEL_VERSION} \
    kernel-module-qcom-ipcc-${KERNEL_VERSION} \
    kernel-module-ufs-qcom-${KERNEL_VERSION} \
    kernel-module-ufshcd-core-${KERNEL_VERSION} \
    kernel-module-ufshcd-pltfrm-${KERNEL_VERSION} \
    kernel-module-pinctrl-sa8797p-${KERNEL_VERSION} \
    kernel-module-virtio-mmio-${KERNEL_VERSION} \
    kernel-module-qcom-scm-oot-${KERNEL_VERSION} \
    kernel-module-qtee-shmbridge-${KERNEL_VERSION} \
    kernel-module-qcom-smcinvoke-${KERNEL_VERSION} \
    kernel-module-dice-vm-${KERNEL_VERSION} \
    kernel-module-aquantia-${KERNEL_VERSION}  \
    kernel-module-qcom-geni-se-${KERNEL_VERSION} \
    kernel-module-qcom-ccu-qup-${KERNEL_VERSION} \
    kernel-module-qcom-geni-serial-${KERNEL_VERSION} \
    kernel-module-gpi-${KERNEL_VERSION} \
    kernel-module-arm-smmu-qcom-fusa-${KERNEL_VERSION} \
    kernel-module-pinctrl-fusa-${KERNEL_VERSION} \
    kernel-module-vendor-uscmi-${KERNEL_VERSION} \
    kernel-module-msm-hab-${KERNEL_VERSION} \
    kernel-module-hyp-udmabuf-${KERNEL_VERSION} \
    kernel-module-mdt-loader-${KERNEL_VERSION} \
    kernel-module-gh-msgq-${KERNEL_VERSION} \
    kernel-module-gh-arm-drv-${KERNEL_VERSION} \
    kernel-module-gh-rm-drv-${KERNEL_VERSION} \
    kernel-module-gunyah-${KERNEL_VERSION} \
    kernel-module-hvc-gunyah-${KERNEL_VERSION} \
"

RUSTVERSION = "1.75%"
```

## conf/machine/include/basemachine.inc
```bitbake
BASEMACHINE ??= ""

# Add BASEMACHINE to machine overrides
MACHINEOVERRIDES =. "${@['', '${BASEMACHINE}:']['${BASEMACHINE}' != '']}"

# Define BASEMACHINE_ARCH
BASEMACHINE_ARCH = "${@['${MACHINE_ARCH}', '${BASEMACHINE}']['${BASEMACHINE}' != '']}"

# Add BASEMACHINE_ARCH to PACKAGE_ARCHS. 
# This variable is originally set in bitbake.conf
PACKAGE_ARCHS .= "${@['', ' ${BASEMACHINE_ARCH}']['${BASEMACHINE_ARCH}' != '${MACHINE_ARCH}']}"
PACKAGE_ARCHS[vardepsexclude] += "BASEMACHINE_ARCH"

# Default Image names
BOOTIMAGE_TARGET ?= "${PRODUCT}-boot.img"
CACHEIMAGE_TARGET ?= "${PRODUCT}-cache.ext4"
PERSISTIMAGE_TARGET ?= "${PRODUCT}-persist.ext4"
RECOVERYIMAGE_TARGET ?= "${PRODUCT}-recoveryfs.ext4"
SYSTEMIMAGE_TARGET ?= "${PRODUCT}-sysfs.ext4"
SYSTEMRWIMAGE_TARGET ?= "${PRODUCT}-systemrw.ext4"
USERDATAIMAGE_TARGET ?= "${PRODUCT}-usrfs.ext4"
VBMETAIMAGE_TARGET ?= "${PRODUCT}-vbmeta.img"
VENDORBOOTIMAGE_TARGET ?= "${PRODUCT}-vendor_boot.img"
BOOTINIT_TARGET ?= "${PRODUCT}-boot_init.img"

# Flag to Enable QPermissions
QPERMISSIONS_ENABLE ?= "0"
```

## conf/machine/include/gen5.inc
```bitbake
include conf/machine/include/basemachine.inc
include conf/machine/include/qclinux-bbmask.inc
include conf/distro/include/qclinux-bbmask-prop.inc
SOC_FAMILY = "gen5"
SOC_FAMILY ?= "sa-common"
include conf/machine/include/soc-family.inc
PRODUCT = "${MACHINE}"
PREFERRED_PROVIDER_virtual/kernel = "linux-qcom-custom-rt"
PREFERRED_PROVIDER_virtual/kernel-headers = "linux-kernel-qcom-headers"
PREFERRED_VERSION_linux-qcom-custom-rt = "6.6"

#grep use GPL-2.0-only version from meta-gplv2/recipes-extended/grep
PREFERRED_VERSION_grep = "2.5%"
PREFERRED_VERSION_libgpiod = "2.1.2"
preferred-kernel = "PREFERRED_VERSION_linux-qcom-custom-rt"
kernel-version = "6.6"
# Prefer gbm
PREFERRED_PROVIDER_virtual/libgbm = "gbm"

PREFERRED_VERSION_android-tools = "5.1.1.r37"
PREFERRED_VERSION_adreno = "0.1"
# Prefer adreno
PREFERRED_PROVIDER_virtual/wayland-egl  = "adreno"
PREFERRED_PROVIDER_virtual/egl          = "adreno"
PREFERRED_PROVIDER_virtual/libgles1     = "adreno"
PREFERRED_PROVIDER_virtual/libgles2     = "adreno"
VIRTUAL-RUNTIME_wayland-egl  = "adreno"
VIRTUAL-RUNTIME_egl          = "adreno"
VIRTUAL-RUNTIME_libgles1     = "adreno"
VIRTUAL-RUNTIME_libgles2     = "adreno"

# Enables timestamping functionality during building the kernel
KERNEL_DEBUG_TIMESTAMPS = "1"
# mesa provides these packags and others like virtual/libgl.
# This is to enable mesa, adreno and gbm work together, and pass
# yocot-check-layer script check.
BB_MULTI_PROVIDER_ALLOWED += "virtual/wayland-egl virtual/egl virtual/libgles1 virtual/libgles2 virtual/libgbm"

SERIAL_CONSOLE ?= "${@['', '115200 ttyMSM0'][d.getVar('VARIANT', True) == ('' or 'debug')]}"
SERIAL_CONSOLES = "115200;ttyMSM0"

IMAGE_FSTYPES ?= "ext4"
PAGE_SIZE ?= '4096'
IMAGE_ROOTFS_ALIGNMENT = "4096"
EXTRA_IMAGECMD_ext4 += " -b 4096 "

IMAGE_CLASSES += "qimage"

IMAGE_INSTALL += "\
    openssh-scp \
    openssh-ssh \
    openssh-sshd \
    openssh-sftp \
    openssh-sftp-server \
    "
IMAGE_INSTALL:remove = "${@bb.utils.contains('DISTRO_FEATURES', 'qti-rumi', 'openssh-scp openssh-ssh openssh-sshd openssh-sftp openssh-sftp-server', '', d)}"


IMAGE_FEATURES += "ssh-server-openssh"

EXTRA_IMAGEDEPENDS += "qcom-image-boot:do_sign_boot_img"

IMAGE_FEATURES:append = " read-only-rootfs"

MACHINE_FEATURES += "\
    qti-bluetooth \
    qti-core \
    qti-tools \
    qti-multimedia \
    qti-cv \
    qti-display \
    qti-graphics \
    qti-audio-aw \
    qti-audio-ar \
    qti-data \
    qti-camera \
    qti-safety \
    qti-vnw \
    early-ramdisk-init \
    qti-security \
    qti-umd \
    qti-vmm \
    qti-compute-platform \
    qti-wlan \
    qti-wlan-hsp \
    qti-wlan-hmt \
"

MACHINE_FEATURES:remove = "${@bb.utils.contains('FACTORY_TEST', '1', 'qti-vmm', '', d)}"
SECTOOLS_VERSION = "sectools-v2"
SECTOOLS_SECURITY_PROFILE = "nord_tz_security_profile.xml"

SECTOOLS_V2_MULTI_PROFILE_SIGNING ?= "1"
NORD_SECTOOLS_SECURITY_PROFILE = "nord_tz_security_profile.xml"
SECA_SECTOOLS_SECURITY_PROFILE = "seca_tz_security_profile.xml"
SECTOOLS_V2_SECURITY_PROFILES = "${NORD_SECTOOLS_SECURITY_PROFILE} ${SECA_SECTOOLS_SECURITY_PROFILE}"

MACHINE_FEATURES:append = " qti-qcnode"
```
